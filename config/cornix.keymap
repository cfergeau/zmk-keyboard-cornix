/*
 * Copyright (c) 2020 The ZMK Contributors
 *
 * SPDX-License-Identifier: MIT
 */

#include "zmk-helpers/helper.h"
#include "includes/cornix54.h"
#include "../zmk-config-selenium/include/selenium/selenium.keymap"

#define SELENIUM_KEYMAP_BINDINGS(LOUT1,  LROW1,  RROW1,  ROUT1, \
                                 LOUT2,  LROW2,  RROW2,  ROUT2, \
                                 LOUT3,  LROW3,  RROW3,  ROUT3, \
                                 LT1, LT2, LT3,  RT3, RT2, RT1) \
               LOUT1 LROW1               RROW1 ROUT1                \
               LOUT2 LROW2               RROW2 ROUT2                \
               LOUT3 LROW3 &none   &none RROW3 ROUT3                \
   &none &none &none LT1 LT2 LT3   RT3 RT2 RT1 &none &none &none
